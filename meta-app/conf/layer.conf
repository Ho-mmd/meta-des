## meta-app/conf/layer.conf
```bitbake
# We have a conf and classes directory, add to BBPATH
BBPATH .= ":${LAYERDIR}"

# We have recipes-* directories, add to BBFILES
BBFILES += "${LAYERDIR}/recipes-*/*/*.bb \
            ${LAYERDIR}/recipes-*/*/*.bbappend"

BBFILE_COLLECTIONS += "meta-myapp"
BBFILE_PATTERN_meta-myapp = "^${LAYERDIR}/"
BBFILE_PRIORITY_meta-myapp = "10"

LAYERDEPENDS_meta-myapp = "core"
LAYERSERIES_COMPAT_meta-myapp = "kirkstone"

# Not include X11, wayland for using eglfs
DISTRO_FEATURES:remove = " X11 wayland"

PACKAGECONFIG:append:pn-qtbase = " accessibility"
PACKAGECONFIG:append:pn-qtquickcontrols = " accessibility"

IMAGE_INSTALL:append = " \ 
headunit \
"
```

## meta-env/conf/layer.conf
```bitbake
# We have a conf and classes directory, add to BBPATH
BBPATH .= ":${LAYERDIR}"

# We have recipes-* directories, add to BBFILES
BBFILES += "${LAYERDIR}/recipes-*/*/*.bb \
            ${LAYERDIR}/recipes-*/*/*.bbappend"

BBFILE_COLLECTIONS += "meta-env"
BBFILE_PATTERN_meta-env = "^${LAYERDIR}/"
BBFILE_PRIORITY_meta-env = "10"

LAYERDEPENDS_meta-env = "core"
LAYERSERIES_COMPAT_meta-env = "kirkstone"

IMAGE_INSTALL:append = " \
bash \
net-tools \
iproute2 \
wpa-supplicant \
vim \
openssh \
can-utils \
mesa \
gst-devtools \
gstreamer1.0 \
gstreamer1.0-meta-base \
gstreamer1.0-plugins-base \
gstreamer1.0-plugins-bad \
"
```

## meta-myapp/conf/layer.conf
```bitbake
# We have a conf and classes directory, add to BBPATH
BBPATH .= ":${LAYERDIR}"

# We have recipes-* directories, add to BBFILES
BBFILES += "${LAYERDIR}/recipes-*/*/*.bb \
            ${LAYERDIR}/recipes-*/*/*.bbappend"

BBFILE_COLLECTIONS += "meta-myapp"
BBFILE_PATTERN_meta-myapp = "^${LAYERDIR}/"
BBFILE_PRIORITY_meta-myapp = "7"

LAYERDEPENDS_meta-myapp = "core"
LAYERSERIES_COMPAT_meta-myapp = "kirkstone"

# Not include X11, wayland for using eglfs
DISTRO_FEATURES:remove = "X11 wayland"

PACKAGECONFIG:append_pn-qtbase = " accessibility"
PACKAGECONFIG:append_pn-qtquickcontrols = " accessibility"

IMAGE_INSTALL:append = " vsomeip \
common-api-c++ \ 
common-api-c++-someip \
headunit \
qtdeclarative-qmlplugins \
qtquickcontrols-qmlplugins \
qtquickcontrols2-qmlplugins \
"
```

## meta-piracer/conf/layer.conf
```bitbake
# We have a conf and classes directory, add to BBPATH
BBPATH .= ":${LAYERDIR}"

# We have recipes-* directories, add to BBFILES
BBFILES += "${LAYERDIR}/recipes-*/*/*.bb \
            ${LAYERDIR}/recipes-*/*/*.bbappend"

BBFILE_COLLECTIONS += "meta-piracer"
BBFILE_PATTERN_meta-piracer = "^${LAYERDIR}/"
BBFILE_PRIORITY_meta-piracer = "10"

LAYERDEPENDS_meta-piracer = "core"
LAYERSERIES_COMPAT_meta-piracer = "kirkstone"

IMAGE_INSTALL:append = " gcc \
v4l-utils \
i2c-tools \
rpi-gpio \
opencv \
python3 \
glibc \
adafruit_pca9685 \
adafruit_ina219 \
adafruit_ssd1306 \
adafruit_blinka \
adafruit_bus_device \
adafruit_framebuf \
adafruit_platformdetect \
Adafruit_PureIO \
adafruit_register \
adafruit_requests \
circuitpython_typing \
piracer \
pyftdi \
serial \
typing_extensions \
usb \
"
```
